## firmware/components/aivmt_sp/Kconfig
```kconfig
menu "AIVMT Standardized-Patient"

    config AIVMT_PTT_ENABLE
        bool "Enable push-to-talk (PTT) hardware button for SP encounters"
        default n
        help
            When enabled, the host firmware creates a dedicated GPIO button that
            forwards press/release events to the SpSession encounter state
            (start/stop listening). Leave disabled for boards without a wired PTT
            button; the default build is unaffected.

    config AIVMT_PTT_GPIO
        int "PTT button GPIO number"
        default -1
        depends on AIVMT_PTT_ENABLE
        help
            GPIO the push-to-talk button is wired to (active-low). Set to the
            physical button pin on your board. -1 means unconfigured.

    config AIVMT_ENCOUNTER_POST_URL
        string "Local server URL to POST a finished SP encounter"
        default "http://CHANGE_ME_LOCAL_SERVER:8003/aivmt/encounter"
        help
            HTTP endpoint on the self-hosted local server that receives the
            de-identified encounter JSON (telemetry + transcript). Local-only by
            policy (patient confidentiality); no cloud fallback.

endmenu
```

## firmware/sdkconfig.defaults.aivmt
```kconfig
# AIVMT build defaults — append to the fork's sdkconfig.defaults.
# (Comments mark decisions; values to be confirmed in menuconfig.)

# Logging
CONFIG_LOG_DEFAULT_LEVEL_INFO=y

# Board: bread-compact-wifi (set via the fork's board-selection Kconfig)
# TODO: CONFIG_BOARD_TYPE_BREAD_COMPACT_WIFI=y  (exact symbol per fork)

# Standardized OSCE turns: prefer push-to-talk half-duplex over free-dialogue wake-word
# (clean turn segmentation -> better transcripts + mitigates lack of hardware AEC).
# TODO: expose AIVMT_PTT_GPIO and AIVMT_PTT_ENABLE in components/aivmt_sp/Kconfig

# Local-only / confidentiality: point endpoint at the self-hosted server; no cloud fallback.
# TODO: AIVMT_SERVER_URL="ws://<local-server>:<port>/xiaozhi/v1/"
# TODO: AIVMT_LOCAL_ONLY=y
```

## firmware/sdkconfig.defaults.flashed
```kconfig
CONFIG_COMPILER_OPTIMIZATION_SIZE=y
CONFIG_COMPILER_CXX_EXCEPTIONS=y
CONFIG_COMPILER_CXX_EXCEPTIONS_EMG_POOL_SIZE=1024
CONFIG_COMPILER_CXX_RTTI=y

CONFIG_BOOTLOADER_COMPILER_OPTIMIZATION_PERF=y
CONFIG_BOOTLOADER_LOG_LEVEL_NONE=y
CONFIG_BOOTLOADER_SKIP_VALIDATE_ALWAYS=y
CONFIG_BOOTLOADER_APP_ROLLBACK_ENABLE=y

CONFIG_HTTPD_MAX_REQ_HDR_LEN=2048
CONFIG_HTTPD_MAX_URI_LEN=2048

CONFIG_PARTITION_TABLE_CUSTOM=y
CONFIG_PARTITION_TABLE_CUSTOM_FILENAME="partitions/v2/16m.csv"
CONFIG_PARTITION_TABLE_OFFSET=0x8000

CONFIG_ESP_TASK_WDT_TIMEOUT_S=10
CONFIG_FREERTOS_GENERATE_RUN_TIME_STATS=y
CONFIG_FREERTOS_USE_STATS_FORMATTING_FUNCTIONS=y

CONFIG_ESP_MAIN_TASK_STACK_SIZE=8192
CONFIG_MBEDTLS_DYNAMIC_BUFFER=y
CONFIG_MBEDTLS_SSL_KEEP_PEER_CERTIFICATE=n
CONFIG_ESP_WIFI_IRAM_OPT=n
CONFIG_ESP_WIFI_RX_IRAM_OPT=n
CONFIG_ESP_WIFI_DYNAMIC_RX_MGMT_BUFFER=y

# These entries are copied from ESP-HI (ESP32C3) to reduce memory usage
CONFIG_ESP_WIFI_STATIC_RX_BUFFER_NUM=6
CONFIG_ESP_WIFI_DYNAMIC_RX_BUFFER_NUM=8
CONFIG_NEWLIB_NANO_FORMAT=y
CONFIG_ESP_WIFI_ENTERPRISE_SUPPORT=n

CONFIG_CODEC_I2C_BACKWARD_COMPATIBLE=n

# Fix ML307 FIFO Overflow
CONFIG_UART_ISR_IN_IRAM=y

# Fix ESP_SSL error
CONFIG_MBEDTLS_SSL_RENEGOTIATION=n

# LVGL 9.2.2

CONFIG_LV_OS_NONE=y
CONFIG_LV_USE_CLIB_MALLOC=y
CONFIG_LV_USE_CLIB_STRING=y
CONFIG_LV_USE_CLIB_SPRINTF=y
CONFIG_LV_USE_IMGFONT=y
CONFIG_LV_USE_ASSERT_STYLE=y

# Use compressed font
CONFIG_LV_FONT_FMT_TXT_LARGE=y
CONFIG_LV_USE_FONT_COMPRESSED=n
CONFIG_LV_USE_FONT_PLACEHOLDER=n
CONFIG_LV_USE_LODEPNG=y

# Disable extra widgets to save flash size
CONFIG_LV_USE_ANIMIMG=n
CONFIG_LV_USE_CALENDAR=n
CONFIG_LV_USE_CALENDAR_HEADER_ARROW=n
CONFIG_LV_USE_CALENDAR_HEADER_DROPDOWN=n
CONFIG_LV_USE_CHART=n
CONFIG_LV_USE_KEYBOARD=n
CONFIG_LV_USE_LED=n
CONFIG_LV_USE_LIST=n
CONFIG_LV_USE_MENU=n
CONFIG_LV_USE_MSGBOX=n
CONFIG_LV_USE_SPAN=n
CONFIG_LV_USE_SPINBOX=n
CONFIG_LV_USE_SPINNER=n
CONFIG_LV_USE_TABVIEW=n
CONFIG_LV_USE_TILEVIEW=n
CONFIG_LV_USE_WIN=n

CONFIG_LV_BUILD_EXAMPLES=n
CONFIG_LV_BUILD_DEMOS=n


# AIVMT build defaults — append to the fork's sdkconfig.defaults.
# (Comments mark decisions; values to be confirmed in menuconfig.)

# Logging
CONFIG_LOG_DEFAULT_LEVEL_INFO=y

# Board: bread-compact-wifi (verified symbol: main/Kconfig.projbuild "choice BOARD_TYPE",
# default for esp32s3; set explicitly to document intent)
CONFIG_BOARD_TYPE_BREAD_COMPACT_WIFI=y

# Standardized OSCE turns: prefer push-to-talk half-duplex over free-dialogue wake-word
# (clean turn segmentation -> better transcripts + mitigates lack of hardware AEC).
# TODO: expose AIVMT_PTT_GPIO and AIVMT_PTT_ENABLE in components/aivmt_sp/Kconfig

# Local-only / confidentiality: point endpoint at the self-hosted server; no cloud fallback.
# TODO: AIVMT_SERVER_URL="ws://<local-server>:<port>/xiaozhi/v1/"
# TODO: AIVMT_LOCAL_ONLY=y
CONFIG_AIVMT_PTT_ENABLE=y
CONFIG_AIVMT_PTT_GPIO=0
CONFIG_AIVMT_ENCOUNTER_POST_URL="http://192.168.31.229:8003/aivmt/encounter"
```
